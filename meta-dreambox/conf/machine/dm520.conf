## meta-dreambox/conf/machine/dm520.conf
```bitbake
#@TYPE: Machine
#@NAME: Dreambox DM520
#@DESCRIPTION: Machine configuration for the Dreambox DM520

DREAMBOX_FEATURES = "cec ci usbconsole"
SOC_FAMILY = "bcm73625"
SERIAL_CONSOLES = "1000000;ttyS0"

MACHINE_ESSENTIAL_EXTRA_RDEPENDS += "dreambox-dvb-modules"
MACHINE_ESSENTIAL_EXTRA_RRECOMMENDS += "dreambox-secondstage"

require conf/machine/include/dreambox-mips32el.inc
require conf/machine/include/soc-family.inc
```

## meta-dreambox/conf/machine/dm7080.conf
```bitbake
#@TYPE: Machine
#@NAME: Dreambox DM7080
#@DESCRIPTION: Machine configuration for the Dreambox DM7080

DREAMBOX_FEATURES = "cec ci usbconsole encoder"
SOC_FAMILY = "bcm7435"
SERIAL_CONSOLES = "1000000;ttyS0"

MACHINE_ESSENTIAL_EXTRA_RDEPENDS += "dreambox-dvb-modules"
MACHINE_ESSENTIAL_EXTRA_RRECOMMENDS += "dreambox-secondstage"

require conf/machine/include/dreambox-mips32el.inc
require conf/machine/include/soc-family.inc
```

## meta-dreambox/conf/machine/dm820.conf
```bitbake
#@TYPE: Machine
#@NAME: Dreambox DM820
#@DESCRIPTION: Machine configuration for the Dreambox DM820

DREAMBOX_FEATURES = "cec usbconsole encoder"
SOC_FAMILY = "bcm7435"
SERIAL_CONSOLE = "1000000 ttyS0"

MACHINE_ESSENTIAL_EXTRA_RDEPENDS += "dreambox-dvb-modules"
MACHINE_ESSENTIAL_EXTRA_RRECOMMENDS += "dreambox-secondstage"

require conf/machine/include/dreambox-mips32el.inc
require conf/machine/include/soc-family.inc
```

## meta-dreambox/conf/machine/dm920.conf
```bitbake
#@TYPE: Machine
#@NAME: Dreambox DM920
#@DESCRIPTION: Machine configuration for the Dreambox DM920

PREFERRED_PROVIDER_virtual/egl ?= "libvc5dream"
PREFERRED_PROVIDER_virtual/libgles1 ?= "libvc5dream"
PREFERRED_PROVIDER_virtual/libgles2 ?= "libvc5dream"

PREFERRED_PROVIDER_virtual/libgl ?= "mesa-gl"
PREFERRED_PROVIDER_virtual/mesa ?= "mesa-gl"

DREAMBOX_FEATURES = "cec ci usbconsole encoder nrf52"
SOC_FAMILY = "bcm7439"
SERIAL_CONSOLE = "1000000 ttyS0"

MACHINE_ESSENTIAL_EXTRA_RDEPENDS += "dreambox-dvb-modules"

TARGET_ARCH = "arm"
DEFAULTTUNE = "cortexa15hf-neon-vfpv4"
OLDEST_KERNEL = "3.14"

require conf/machine/include/dreambox.inc
require conf/machine/include/soc-family.inc
require conf/machine/include/tune-cortexa15.inc
```

## meta-dreambox/conf/machine/dreamone.conf
```bitbake
require conf/machine/include/arm/arch-armv8.inc

MACHINE_ESSENTIAL_EXTRA_RRECOMMENDS = "bcmdhd dreambox-dvb-modules"
MACHINE_EXTRA_RRECOMMENDS = "kernel-modules"

SERIAL_CONSOLES = "1000000;ttyS0"

PREFERRED_PROVIDER_virtual/egl ?= "meson-mali"
PREFERRED_PROVIDER_virtual/libgles2 ?= "meson-mali"
PREFERRED_PROVIDER_virtual/libgl ?= "mesa-gl"
PREFERRED_PROVIDER_virtual/mesa ?= "mesa-gl"

PREFERRED_PROVIDER_virtual/kernel ?= "linux-meson64"
PREFERRED_VERSION_linux-meson64 ?= "4.9%"

UBOOT_ENTRYPOINT = "0x1080000"

KERNEL_CLASSES ?= "kernel-fitimage"
KERNEL_IMAGETYPE ?= "Image.gz"

MACHINE_FEATURES = "serial usbgadget usbhost vfat ext2 rtc alsa screen"
DREAMBOX_FEATURES = "cec nrf52 usbconsole"

SOC_FAMILY = "meson64"
require conf/machine/include/soc-family.inc
```

## meta-dreambox/conf/machine/include/dreambox-armv7ahf-neon.inc
```bitbake
# dreambox-mips32el.inc

LINUXLIBCVERSION = "4.4"
OLDEST_KERNEL = "3.14"

TARGET_ARCH = "arm"
DEFAULTTUNE = "armv7ahf-neon"

require conf/machine/include/dreambox.inc
require conf/machine/include/tune-cortexa7.inc
```

## meta-dreambox/conf/machine/include/dreambox-board.inc
```bitbake
MACHINE_ESSENTIAL_EXTRA_RDEPENDS += "dreambox-dvb-modules dreambox-secondstage"
PREFERRED_PROVIDER_virtual/bootloader = "dreambox-secondstage"
```

## meta-dreambox/conf/machine/include/dreambox-mips32el.inc
```bitbake
# dreambox-mips32el.inc

OLDEST_KERNEL = "3.4"

TARGET_ARCH = "mipsel"
DEFAULTTUNE = "mips32el"

require conf/machine/include/dreambox.inc
require conf/machine/include/tune-mips32.inc
require conf/machine/include/dreambox-v3d.inc
```

## meta-dreambox/conf/machine/include/dreambox.inc
```bitbake
# dreambox.inc

GLIBC_EXTRA_OECONF = "--with-tls --with-__thread"

MACHINE_ESSENTIAL_EXTRA_RDEPENDS += "packagegroup-opendreambox-essential"
MACHINE_FEATURES += "alsa kernel26 wifi"

PREFERRED_PROVIDER_virtual/kernel = "linux-dreambox"
```

## meta-opendreambox/conf/distro/opendreambox.conf
```bitbake
#@TYPE: Distribution
#@NAME: OpenDreambox
#@DESCRIPTION: Distribution configuration for OpenDreambox

#USER_CLASSES += "image-prelink"
INHERIT += "recipe_sanity"

DISTRO_NAME = "${DISTRO}"
DISTRO_VERSION = "2.5.0"

# meta/conf/distro/include/default-distrovars.inc
LOCALE_UTF8_ONLY ?= "1"
DISTRO_FEATURES_DEFAULT ?= "alsa argp bluetooth ext2 largefile usbhost wifi xattr nfs zeroconf pci \
                            ppp smbfs systemd xinetd"
DISTRO_FEATURES_BACKFILL_CONSIDERED = "pulseaudio"
DISTRO_FEATURES_GCC ?= ""
DISTRO_FEATURES_GCC_mipsel ?= " mplt"
DISTRO_FEATURES_GFX ?= " opengl"
DISTRO_FEATURES_append = "${DISTRO_FEATURES_GCC}${DISTRO_FEATURES_GFX}"

# meta/conf/distro/defaultsetup.conf
PACKAGE_CLASSES ?= "package_deb"

# meta/recipes-core/sysvinit/sysvinit-inittab_2.88dsf.bb
SYSVINIT_ENABLED_GETTYS = ""

# meta/classes/image_types.bbclass
IMAGE_FSTYPES =+ "tar.xz"
XZ_COMPRESSION_LEVEL ?= ""

# meta/classes/image.bbclass
IMAGE_PKGTYPE ?= "deb"

# package versions
PREFERRED_VERSION_gnupg ?= "1.4.7"
PREFERRED_VERSION_xserver-nodm-init ?= "1.0"

require conf/go1.8-defaults.conf
GOLANG_X_CRYPTO_SRCREV = "4d70248d17d12d1edb7153434a74001c1540938b"
GOLANG_X_NET_SRCREV = "02ac38e2528ff4adea90f184d71a3faa04b4b1b0"
GOLANG_X_TEXT_SRCREV = "836efe42bb4aa16aaa17b9c155d8813d336ed720"
GOLANG_X_TOOLS_SRCREV = "3da34b1b520a543128e8441cd2ffffc383111d03"

PREFERRED_PROVIDER_jpeg ?= "libjpeg-turbo"
PREFERRED_PROVIDER_jpeg-native ?= "libjpeg-turbo-native"

PREFERRED_PROVIDER_virtual/fftw = "fftw"

PREFERRED_PROVIDER_virtual/update-alternatives = "dpkg"
PREFERRED_PROVIDER_virtual/update-alternatives-native = "dpkg-native"
PREFERRED_PROVIDER_virtual/nativesdk-update-alternatives = "nativesdk-dpkg"

VIRTUAL-RUNTIME_init_manager = "systemd"
VIRTUAL-RUNTIME_initscripts = "systemd-compat-units"
VIRTUAL-RUNTIME_update-alternatives = "update-alternatives-dpkg"

PACKAGECONFIG_pn-apt = "lzma opkg"

PACKAGECONFIG_pn-cogl-1.0 = "egl-null gles2"
EXTRA_OECONF_append_pn-cogl-1.0 = " --disable-introspection"

PACKAGECONFIG_pn-connman = "bluez l2tp openvpn pptp systemd vpnc wifi"

PACKAGECONFIG_pn-curl = "ssl zlib \
        ${@bb.utils.contains('DISTRO_FEATURES', 'ipv6', 'ipv6', '', d)}"

PACKAGECONFIG_pn-dpkg = "update-alternatives xz"
PACKAGECONFIG_pn-dpkg-native = "update-alternatives xz"
PACKAGECONFIG_pn-nativesdk-dpkg = "update-alternatives xz"

PACKAGECONFIG_pn-glmark2 = ""

ORCPACKAGECONFIG = "orc"
ORCPACKAGECONFIG_mipsel = ""

PACKAGECONFIG_pn-gstreamer1.0-plugins-base = " \
    ${@bb.utils.contains('DISTRO_FEATURES', 'x11', 'x11', '', d)} \
    ${@bb.utils.contains('DISTRO_FEATURES', 'alsa', 'alsa', '', d)} \
    ${ORCPACKAGECONFIG} ivorbis ogg theora vorbis pango"

PACKAGECONFIG_pn-gstreamer1.0-plugins-good = " \
    ${@bb.utils.contains('DISTRO_FEATURES', 'x11', 'x11', '', d)} \
    ${@bb.utils.contains('DISTRO_FEATURES', 'pulseaudio', 'pulseaudio', '', d)} \
    ${ORCPACKAGECONFIG} cairo flac gdk-pixbuf gudev jpeg libpng soup speex taglib"

PACKAGECONFIG_pn-gstreamer1.0-plugins-bad = " \
    ${@bb.utils.contains('DISTRO_FEATURES', 'wayland', 'wayland', '', d)} \
    ${@bb.utils.contains('DISTRO_FEATURES', 'bluetooth', 'bluez', '', d)} \
    ${@bb.utils.contains('DISTRO_FEATURES', 'directfb', 'directfb', '', d)} \
    ${ORCPACKAGECONFIG} curl uvch264 neon sndfile \
    hls sbc dash bz2 smoothstreaming \
    opus faad libmms assrender rtmp"

PACKAGECONFIG_pn-gstreamer1.0-plugins-ugly = " \
    ${ORCPACKAGECONFIG} a52dec lame mad mpeg2dec cdio"

PACKAGECONFIG_pn-ffmpeg = "avdevice avfilter avcodec avformat swresample swscale postproc"

PACKAGECONFIG_pn-kodi = "openglesv2"

PACKAGECONFIG_GL_pn-libsdl2 = "${@bb.utils.contains('DISTRO_FEATURES', 'opengl', 'gles2', '', d)}"

PACKAGECONFIG_pn-libunwind = "lzma"

PACKAGECONFIG_pn-mesa-demos = "drm osmesa freetype2 gbm egl gles2"

PACKAGECONFIG_pn-nfs-utils = "nfsv4 nfsv41 ipv6 tirpc"

PACKAGECONFIG_DISTRO_pn-qtbase = "icu sql-sqlite"
PACKAGECONFIG_FB_pn-qtbase = "linuxfb"
PACKAGECONFIG_GL_pn-qtbase = "${@bb.utils.contains('DISTRO_FEATURES', 'opengl', 'eglfs gles2', '', d)}"
EXTRA_QMAKEVARS_PRE_pn-qtbase = "QT_CONFIG-=eglfs_egldevice"
PACKAGECONFIG_pn-qtdeclarative = ""
PACKAGECONFIG_pn-qtwebkit = ""

PACKAGECONFIG_pn-samba = "systemd zeroconf"

PACKAGECONFIG_pn-systemd = "hostnamed ldconfig localed logind machined myhostname randomseed sysusers utmp xz"

PACKAGECONFIG_pn-weston = "${@bb.utils.contains('DISTRO_FEATURES', 'wayland', 'kms wayland', '', d)} \
                           ${@bb.utils.contains('DISTRO_FEATURES', 'x11', 'x11', '', d)} \
                           ${@bb.utils.contains('DISTRO_FEATURES', 'opengl', 'gles', '', d)} \
                           ${@bb.utils.contains('DISTRO_FEATURES', 'pam', 'launch', '', d)}"

PACKAGECONFIG_pn-wpa-supplicant = "openssl"

PACKAGECONFIG_pn-xserver-xorg = "dri2 udev"

ROOT_HOME ?= "/root"

LICENSE_FLAGS_WHITELIST = "commercial"

# build some core libs with better compiler optimization for better performance
FULL_OPTIMIZATION_O3 = "-O3 -pipe ${DEBUG_FLAGS}"
FULL_OPTIMIZATION_pn-flac = "${FULL_OPTIMIZATION_O3}"
FULL_OPTIMIZATION_pn-jpeg = "${FULL_OPTIMIZATION_O3}"
FULL_OPTIMIZATION_pn-lame = "${FULL_OPTIMIZATION_O3}"
FULL_OPTIMIZATION_pn-liba52 = "${FULL_OPTIMIZATION_O3}"
FULL_OPTIMIZATION_pn-libdca = "${FULL_OPTIMIZATION_O3}"
FULL_OPTIMIZATION_pn-libgcrypt = "${FULL_OPTIMIZATION_O3}"
FULL_OPTIMIZATION_pn-libmad = "${FULL_OPTIMIZATION_O3}"
FULL_OPTIMIZATION_pn-libogg = "${FULL_OPTIMIZATION_O3}"
FULL_OPTIMIZATION_pn-libpng = "${FULL_OPTIMIZATION_O3}"
FULL_OPTIMIZATION_pn-libsamplerate = "${FULL_OPTIMIZATION_O3}"
FULL_OPTIMIZATION_pn-libvorbis = "${FULL_OPTIMIZATION_O3}"
FULL_OPTIMIZATION_pn-tremor = "${FULL_OPTIMIZATION_O3}"
FULL_OPTIMIZATION_pn-zlib = "${FULL_OPTIMIZATION_O3}"

# Drop unused PACKAGE_EXTRA_ARCHS
PACKAGE_EXTRA_ARCHS = "${TUNE_PKGARCH}"

PREMIRRORS ?= "\
bzr://.*/.*   http://dreamboxupdate.com/sources-mirror/ \n \
cvs://.*/.*   http://dreamboxupdate.com/sources-mirror/ \n \
git://.*/.*   http://dreamboxupdate.com/sources-mirror/ \n \
hg://.*/.*    http://dreamboxupdate.com/sources-mirror/ \n \
osc://.*/.*   http://dreamboxupdate.com/sources-mirror/ \n \
p4://.*/.*    http://dreamboxupdate.com/sources-mirror/ \n \
svn://.*/.*   http://dreamboxupdate.com/sources-mirror/ \n \
"

MIRRORS =+ "\
ftp://.*/.*    http://dreamboxupdate.com/sources-mirror/ \n \
http://.*/.*   http://dreamboxupdate.com/sources-mirror/ \n \
https://.*/.*  http://dreamboxupdate.com/sources-mirror/ \n \
"

DREAMBOX_FEATURES ??= ""
```

## meta-opendreambox/conf/layer.conf
```bitbake
# We have a conf and classes directory, append to BBPATH
BBPATH .= ":${LAYERDIR}"
# We have recipes-* directories, add to BBFILESS
BBFILES += "${LAYERDIR}/recipes-*/*/*.bb ${LAYERDIR}/recipes-*/*/*.bbappend"

BBFILE_COLLECTIONS += "opendreambox-layer"
BBFILE_PATTERN_opendreambox-layer = "^${LAYERDIR}/"
BBFILE_PRIORITY_opendreambox-layer = "20"

# This should only be incremented on significant changes that will
# cause compatibility issues with other layers
LAYERVERSION_opendreambox-layer = "1"

# Set a variable to get to the top of the metadata location
OPENDREAMBOX_BASE := '${@os.path.normpath("${LAYERDIR}/../")}'
```
