## meta-bsp/common/conf/layer.conf
```bitbake
# We have a conf directory, add to BBPATH
BBPATH .= ":${LAYERDIR}"
# We have a recipes directory, add to BBFILES
BBFILES += "${LAYERDIR}/recipes/*/*.bb"

BBFILE_COLLECTIONS += "bsp-common"
BBFILE_PATTERN_bsp-common = "^${LAYERDIR}/"
BBFILE_PRIORITY_bsp-common = "30"

# This should only be incremented on significant changes that will
# cause compatibility issues with other layers
LAYERVERSION_bsp-common = "1"

SIGGEN_EXCLUDERECIPES_ABISAFE += " \
  dreambox-bootlogo \
  dreambox-secondstage \
"
```

## meta-bsp/common/conf/machine/include/dreambox-board.inc
```bitbake
MACHINE_ESSENTIAL_EXTRA_RDEPENDS += "dreambox-bootlogo dreambox-dvb-modules dreambox-secondstage"
PREFERRED_PROVIDER_virtual/bootloader = "dreambox-secondstage"
```

## meta-bsp/common/conf/machine/include/dreambox-legacy.inc
```bitbake
KERNEL_IMAGETYPE = "vmlinux"
KERNEL_OUTPUT = "${KERNEL_IMAGETYPE}"
KERNEL_CONSOLE = "${@base_contains('DREAMBOX_FEATURES', 'usbconsole', 'ttyS0,115200', 'null', d)}"

DREAMBOX_BUILDIMAGE = "buildimage --arch ${MACHINE} ${EXTRA_BUILDCMD} \
	--erase-block-size ${DREAMBOX_ERASE_BLOCK_SIZE} \
	--sector-size ${DREAMBOX_SECTOR_SIZE}"
```

## meta-bsp/common/conf/machine/include/dreambox-mips32el-nf.inc
```bitbake
# dreambox-mips32el-nf.inc

# squashfs img support is not yet supported for old 2.6.18 kernel
# we have to add squashfs lzma support to kernel and add squashfs-tools
# for the old squashfs version

SQUASHFS_IMG_SUPPORT_ENABLED = "0"
DREAMBOX_KERNEL_VERSION = "2.6.18"
LINUXLIBCVERSION = "2.6.18"
OLDEST_KERNEL = "2.6.18"

TARGET_ARCH = "mipsel"
DEFAULTTUNE = "mips32el-nf"

require conf/machine/include/dreambox.inc
require conf/machine/include/tune-mips32.inc
```

## meta-bsp/common/conf/machine/include/dreambox-mips32el.inc
```bitbake
# dreambox-mips32el.inc

LINUXLIBCVERSION = "3.2"
OLDEST_KERNEL = "3.2"

TARGET_ARCH = "mipsel"
DEFAULTTUNE = "mips32el"

require conf/machine/include/dreambox.inc
require conf/machine/include/tune-mips32.inc
```

## meta-bsp/common/conf/machine/include/dreambox.inc
```bitbake
# dreambox.inc

GLIBC_EXTRA_OECONF = "--with-tls --with-__thread"

MACHINE_ESSENTIAL_EXTRA_RDEPENDS += "packagegroup-opendreambox-essential"
MACHINE_FEATURES += "alsa kernel26 wifi"

PREFERRED_PROVIDER_virtual/kernel = "linux-dreambox"

KERNEL_IMAGETYPE = "vmlinux"
KERNEL_OUTPUT = "${KERNEL_IMAGETYPE}"
KERNEL_CONSOLE = "${@base_contains('DREAMBOX_FEATURES', 'usbconsole', 'ttyS0,115200', 'null', d)}"

DREAMBOX_BUILDIMAGE = "buildimage --arch ${MACHINE} ${EXTRA_BUILDCMD} \
	--erase-block-size ${DREAMBOX_ERASE_BLOCK_SIZE} \
	--sector-size ${DREAMBOX_SECTOR_SIZE}"
```

## meta-bsp/dm500hd/conf/layer.conf
```bitbake
# We have a conf directory, add to BBPATH
BBPATH .= ":${LAYERDIR}"
# We have a recipes directory, add to BBFILES
BBFILES += "${LAYERDIR}/recipes/*/*.bb ${LAYERDIR}/recipes/*/*.bbappend"

BBFILE_COLLECTIONS += "dm500hd"
BBFILE_PATTERN_dm500hd = "^${LAYERDIR}/"
BBFILE_PRIORITY_dm500hd = "40"

# This should only be incremented on significant changes that will
# cause compatibility issues with other layers
LAYERVERSION_dm500hd = "1"
```

## meta-bsp/dm500hd/conf/machine/dm500hd.conf
```bitbake
#@TYPE: Machine
#@NAME: Dreambox DM500HD
#@DESCRIPTION: Machine configuration for the Dreambox DM500HD

DREAMBOX_FEATURES = "cec fan opkgfb usbconsole"
SOC_FAMILY = "bcm7405"

require conf/machine/include/dreambox-brcmnand.inc
require conf/machine/include/dreambox-nand-64mb.inc
require conf/machine/include/dreambox-part-64mb.inc
require conf/machine/include/dreambox-jffs2.inc
require conf/machine/include/dreambox-mips32el.inc
require conf/machine/include/dreambox-board.inc
require conf/machine/include/soc-family.inc
```

## meta-bsp/dm500hdv2/conf/layer.conf
```bitbake
# We have a conf directory, add to BBPATH
BBPATH .= ":${LAYERDIR}"
# We have a recipes directory, add to BBFILES
BBFILES += "${LAYERDIR}/recipes/*/*.bb ${LAYERDIR}/recipes/*/*.bbappend"

BBFILE_COLLECTIONS += "dm500hdv2"
BBFILE_PATTERN_dm500hdv2 = "^${LAYERDIR}/"
BBFILE_PRIORITY_dm500hdv2 = "40"

# This should only be incremented on significant changes that will
# cause compatibility issues with other layers
LAYERVERSION_dm500hdv2 = "1"
```

## meta-bsp/dm500hdv2/conf/machine/dm500hdv2.conf
```bitbake
#@TYPE: Machine
#@NAME: Dreambox DM500HDv2
#@DESCRIPTION: Machine configuration for the Dreambox DM500HDv2

DREAMBOX_FEATURES = "fan usbconsole cec"
SOC_FAMILY = "bcm7405"

require conf/machine/include/dreambox-hw-ecc.inc
require conf/machine/include/dreambox-nand-1024mb-2k.inc
require conf/machine/include/dreambox-part-1024mb.inc
require conf/machine/include/dreambox-ubi.inc
require conf/machine/include/dreambox-mips32el.inc
require conf/machine/include/dreambox-board.inc
require conf/machine/include/soc-family.inc
```

## meta-bsp/dm7020hd/conf/layer.conf
```bitbake
# We have a conf directory, add to BBPATH
BBPATH .= ":${LAYERDIR}"
# We have a recipes directory, add to BBFILES
BBFILES += "${LAYERDIR}/recipes/*/*.bb ${LAYERDIR}/recipes/*/*.bbappend"

BBFILE_COLLECTIONS += "dm7020hd"
BBFILE_PATTERN_dm7020hd = "^${LAYERDIR}/"
BBFILE_PRIORITY_dm7020hd = "40"

# This should only be incremented on significant changes that will
# cause compatibility issues with other layers
LAYERVERSION_dm7020hd = "1"
```

## meta-bsp/dm7020hd/conf/machine/dm7020hd.conf
```bitbake
#@TYPE: Machine
#@NAME: Dreambox DM7020HD
#@DESCRIPTION: Machine configuration for the Dreambox DM7020HD

DREAMBOX_FEATURES = "cec ci usbconsole"
SOC_FAMILY = "bcm7405"

require conf/machine/include/dreambox-hw-ecc.inc
require conf/machine/include/dreambox-nand-1024mb.inc
require conf/machine/include/dreambox-part-1024mb.inc
require conf/machine/include/dreambox-ubi.inc
require conf/machine/include/dreambox-mips32el.inc
require conf/machine/include/dreambox-board.inc
require conf/machine/include/soc-family.inc
```

## meta-bsp/dm7080/conf/layer.conf
```bitbake
# We have a conf directory, add to BBPATH
BBPATH .= ":${LAYERDIR}"
# We have a recipes directory, add to BBFILES
BBFILES += "${LAYERDIR}/recipes-*/*/*.bb ${LAYERDIR}/recipes-*/*/*.bbappend"

BBFILE_COLLECTIONS += "dm7080"
BBFILE_PATTERN_dm7080 = "^${LAYERDIR}/"
BBFILE_PRIORITY_dm7080 = "40"

# This should only be incremented on significant changes that will
# cause compatibility issues with other layers
LAYERVERSION_dm7080 = "1"
```

## meta-bsp/dm7080/conf/machine/dm7080.conf
```bitbake
#@TYPE: Machine
#@NAME: Dreambox DM7020HD
#@DESCRIPTION: Machine configuration for the Dreambox DM7080

PREFERRED_PROVIDER_virtual/egl ?= "libv3ddriver"
PREFERRED_PROVIDER_virtual/libgles2 ?= "libv3ddriver"

PREFERRED_PROVIDER_virtual/libgl ?= "mesa-gl"
PREFERRED_PROVIDER_virtual/mesa ?= "mesa-gl"

DREAMBOX_FEATURES = "cec ci usbconsole"
SOC_FAMILY = "bcm7435"
SERIAL_CONSOLE = "1000000 ttyS0"

MACHINE_ESSENTIAL_EXTRA_RDEPENDS += "dreambox-dvb-modules"

require conf/machine/include/dreambox-mips32el.inc
require conf/machine/include/soc-family.inc
```

## meta-bsp/dm800/conf/layer.conf
```bitbake
# We have a conf directory, add to BBPATH
BBPATH .= ":${LAYERDIR}"
# We have a recipes directory, add to BBFILES
BBFILES += "${LAYERDIR}/recipes/*/*.bb ${LAYERDIR}/recipes/*/*.bbappend"

BBFILE_COLLECTIONS += "dm800"
BBFILE_PATTERN_dm800 = "^${LAYERDIR}/"
BBFILE_PRIORITY_dm800 = "40"

# This should only be incremented on significant changes that will
# cause compatibility issues with other layers
LAYERVERSION_dm800 = "1"
```

## meta-bsp/dm800/conf/machine/dm800.conf
```bitbake
#@TYPE: Machine
#@NAME: Dreambox DM 800 HD PVR
#@DESCRIPTION: Machine configuration for the Dreambox DM 800 HD PVR

DREAMBOX_FEATURES = ""
DREAMBOX_NIMS = "slot"
MACHINE_FEATURES += "modem"

require conf/machine/include/dreambox-brcmnand.inc
require conf/machine/include/dreambox-nand-64mb.inc
require conf/machine/include/dreambox-part-64mb.inc
require conf/machine/include/dreambox-jffs2.inc
require conf/machine/include/dreambox-mipsel-nf.inc
require conf/machine/include/dreambox-legacy-wlan.inc
```

## meta-bsp/dm8000/conf/layer.conf
```bitbake
# We have a conf directory, add to BBPATH
BBPATH .= ":${LAYERDIR}"
# We have a recipes directory, add to BBFILES
BBFILES += "${LAYERDIR}/recipes/*/*.bb ${LAYERDIR}/recipes/*/*.bbappend"

BBFILE_COLLECTIONS += "dm8000"
BBFILE_PATTERN_dm8000 = "^${LAYERDIR}/"
BBFILE_PRIORITY_dm8000 = "40"

# This should only be incremented on significant changes that will
# cause compatibility issues with other layers
LAYERVERSION_dm8000 = "1"
```

## meta-bsp/dm8000/conf/machine/dm8000.conf
```bitbake
#@TYPE: Machine
#@NAME: Dreambox DM 8000 HD PVR
#@DESCRIPTION: Machine configuration for the Dreambox DM 8000 HD PVR

DREAMBOX_FEATURES = "ci dvd libpassthrough xvid asf"
MACHINE_FEATURES += "pci"
SOC_FAMILY = "bcm7400"

require conf/machine/include/dreambox-nand-256mb.inc
require conf/machine/include/dreambox-part-256mb.inc
require conf/machine/include/dreambox-ubi.inc
require conf/machine/include/dreambox-mips32el.inc
require conf/machine/include/dreambox-board.inc
require conf/machine/include/soc-family.inc
```

## meta-bsp/dm800se/conf/layer.conf
```bitbake
# We have a conf directory, add to BBPATH
BBPATH .= ":${LAYERDIR}"
# We have a recipes directory, add to BBFILES
BBFILES += "${LAYERDIR}/recipes/*/*.bb ${LAYERDIR}/recipes/*/*.bbappend"

BBFILE_COLLECTIONS += "dm800se"
BBFILE_PATTERN_dm800se = "^${LAYERDIR}/"
BBFILE_PRIORITY_dm800se = "40"

# This should only be incremented on significant changes that will
# cause compatibility issues with other layers
LAYERVERSION_dm800se = "1"
```

## meta-bsp/dm800se/conf/machine/dm800se.conf
```bitbake
#@TYPE: Machine
#@NAME: Dreambox DM800se
#@DESCRIPTION: Machine configuration for the Dreambox DM800se

DREAMBOX_FEATURES = "fan libpassthrough usbconsole xvid cec asf opkgfb"

require conf/machine/include/dreambox-brcmnand.inc
require conf/machine/include/dreambox-nand-64mb.inc
require conf/machine/include/dreambox-part-64mb.inc
require conf/machine/include/dreambox-jffs2.inc
require conf/machine/include/dreambox-mips32el.inc
require conf/machine/include/dreambox-legacy-wlan.inc
```

## meta-bsp/dm800sev2/conf/layer.conf
```bitbake
# We have a conf directory, add to BBPATH
BBPATH .= ":${LAYERDIR}"
# We have a recipes directory, add to BBFILES
BBFILES += "${LAYERDIR}/recipes/*/*.bb ${LAYERDIR}/recipes/*/*.bbappend"

BBFILE_COLLECTIONS += "dm800sev2"
BBFILE_PATTERN_dm800sev2 = "^${LAYERDIR}/"
BBFILE_PRIORITY_dm800sev2 = "40"

# This should only be incremented on significant changes that will
# cause compatibility issues with other layers
LAYERVERSION_dm800sev2 = "1"
```

## meta-bsp/dm800sev2/conf/machine/dm800sev2.conf
```bitbake
#@TYPE: Machine
#@NAME: Dreambox DM800SEv2
#@DESCRIPTION: Machine configuration for the Dreambox DM800SEv2

DREAMBOX_FEATURES = "cec fan usbconsole"
SOC_FAMILY = "bcm7405"

require conf/machine/include/dreambox-hw-ecc.inc
require conf/machine/include/dreambox-nand-1024mb-2k.inc
require conf/machine/include/dreambox-part-1024mb.inc
require conf/machine/include/dreambox-ubi.inc
require conf/machine/include/dreambox-mips32el.inc
require conf/machine/include/dreambox-board.inc
require conf/machine/include/soc-family.inc
```

## meta-bsp/qemumipsel/conf/layer.conf
```bitbake
# We have a conf directory, add to BBPATH
BBPATH .= ":${LAYERDIR}"
# We have a recipes directory, add to BBFILES
BBFILES += "${LAYERDIR}/recipes/*/*.bb ${LAYERDIR}/recipes/*/*.bbappend"

BBFILE_COLLECTIONS += "qemumipsel"
BBFILE_PATTERN_qemumipsel = "^${LAYERDIR}/"
BBFILE_PRIORITY_qemumipsel = "40"

# This should only be incremented on significant changes that will
# cause compatibility issues with other layers
LAYERVERSION_qemumipsel = "1"
```

## meta-bsp/qemumipsel/conf/machine/qemumipsel.conf
```bitbake
#@TYPE: Machine
#@NAME: qemumipsel
#@DESCRIPTION: Machine configuration for QEMU (mipsel)

require conf/machine/include/dreambox-part-1024mb.inc
require conf/machine/include/dreambox-mips32el.inc
require conf/machine/include/qemu.inc

KERNEL_IMAGETYPE = "vmlinux"
KERNEL_ALT_IMAGETYPE = "vmlinux.bin"

SERIAL_CONSOLE = "115200 ttyS0"

MACHINE_EXTRA_RRECOMMENDS += "kernel-modules"
```

## meta-dreambox/conf/layer.conf
```bitbake
# We have a conf directory, add to BBPATH
BBPATH .= ":${LAYERDIR}"
# We have a recipes directory, add to BBFILES
BBFILES += "${LAYERDIR}/recipes-*/*/*.bb"

BBFILE_COLLECTIONS += "meta-dreambox"
BBFILE_PATTERN_meta-dreambox = "^${LAYERDIR}/"
BBFILE_PRIORITY_meta-dreambox = "30"

# This should only be incremented on significant changes that will
# cause compatibility issues with other layers
LAYERVERSION_meta-dreambox = "1"

SIGGEN_EXCLUDERECIPES_ABISAFE += " \
  dreambox-bootlogo \
  dreambox-secondstage \
"
```
